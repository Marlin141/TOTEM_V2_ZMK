## config/west.yml
```yaml
manifest:
  remotes:
    - name: zmkfirmware
      url-base: https://github.com/zmkfirmware
  projects:
    - name: zmk
      remote: zmkfirmware
      revision: v0.3
      import: app/west.yml
    - name: zmk-helpers
      remote: urob
      revision: v0.3 # Needs to match the ZMK releace defined above 
  self:
    path: config
```
